## configs/stm32h743_fk743m2_sd_defconfig
```kconfig
BR2_arm=y
BR2_cortex_m7=y
BR2_TOOLCHAIN_BUILDROOT=y
BR2_GLOBAL_PATCH_DIR="board/stmicroelectronics/stm32h743-fk743m2/patches"
BR2_DOWNLOAD_FORCE_CHECK_HASHES=y
BR2_ROOTFS_POST_BUILD_SCRIPT="board/stmicroelectronics/stm32h743-fk743m2/post-build.sh"
BR2_ROOTFS_POST_IMAGE_SCRIPT="support/scripts/genimage.sh"
BR2_ROOTFS_POST_SCRIPT_ARGS="-c board/stmicroelectronics/stm32h743-fk743m2/genimage.cfg"
BR2_LINUX_KERNEL=y
BR2_LINUX_KERNEL_LATEST_VERSION=y
BR2_LINUX_KERNEL_VERSION="7.1.2"
BR2_LINUX_KERNEL_DEFCONFIG="stm32"
BR2_LINUX_KERNEL_CONFIG_FRAGMENT_FILES="board/stmicroelectronics/stm32h743-fk743m2/linux.fragment"
BR2_LINUX_KERNEL_IMAGE_TARGET_CUSTOM=y
BR2_LINUX_KERNEL_IMAGE_TARGET_NAME="zImage"
BR2_LINUX_KERNEL_DTS_SUPPORT=y
BR2_LINUX_KERNEL_INTREE_DTS_NAME="stm32h743-fk743m2"
BR2_LINUX_KERNEL_CUSTOM_DTS_PATH="board/stmicroelectronics/stm32h743-fk743m2/linux-dts/*"
BR2_LINUX_KERNEL_INSTALL_TARGET=y
BR2_UCLIBC_CONFIG_FRAGMENT_FILES="board/stmicroelectronics/stm32h743-fk743m2/uclibc.fragment"
BR2_TARGET_GENERIC_GETTY_PORT="ttySTM0"
BR2_TARGET_GENERIC_GETTY_BAUDRATE_115200=y
BR2_PACKAGE_BUSYBOX_CONFIG_FRAGMENT_FILES="board/stmicroelectronics/stm32h743-fk743m2/busybox.fragment"
BR2_PACKAGE_EVTEST=y
# BR2_PACKAGE_IFUPDOWN_SCRIPTS is not set
BR2_TARGET_ROOTFS_EXT2=y
BR2_TARGET_ROOTFS_EXT2_SIZE="32M"
# BR2_TARGET_ROOTFS_TAR is not set
BR2_TARGET_UBOOT=y
BR2_TARGET_UBOOT_BUILD_SYSTEM_KCONFIG=y
BR2_TARGET_UBOOT_CUSTOM_GIT=y
BR2_TARGET_UBOOT_CUSTOM_REPO_URL="git@github.com:AlexZaikaSay/u-boot.git"
BR2_TARGET_UBOOT_CUSTOM_REPO_VERSION="feature/FK743M2-IIT6"
BR2_TARGET_UBOOT_BOARD_DEFCONFIG="stm32h743-fk743m2"
BR2_TARGET_UBOOT_NEEDS_OPENSSL=y
BR2_PACKAGE_HOST_GENIMAGE=y
BR2_PACKAGE_HOST_OPENOCD=y
```
